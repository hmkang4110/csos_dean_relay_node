## CMakeLists.txt
```
#
# Copyright (c) 2021 Nordic Semiconductor ASA
#
# SPDX-License-Identifier: LicenseRef-Nordic-5-Clause
#
cmake_minimum_required(VERSION 3.20.0)
find_package(Zephyr REQUIRED HINTS $ENV{ZEPHYR_BASE})
project(central_and_peripheral_hr)

# NORDIC SDK APP START
target_sources(app PRIVATE src/main.c)
# NORDIC SDK APP END
add_subdirectory(src)
```

## prj.conf
```kconfig
CONFIG_BT=y
CONFIG_BT_PERIPHERAL=y
CONFIG_BT_CENTRAL=y
CONFIG_BT_DEVICE_NAME="DE&N"
CONFIG_BT_DEVICE_APPEARANCE=832
CONFIG_BT_MAX_CONN=4
CONFIG_BT_MAX_PAIRED=4
# CONFIG_BT_EXT_ADV=y

CONFIG_BT_SMP=y

# CONFIG_BT_SCAN=y
# CONFIG_BT_SCAN_FILTER_ENABLE=y
# CONFIG_BT_SCAN_UUID_CNT=6
# CONFIG_BT_SCAN_NAME_CNT=4
# CONFIG_BT_SCAN_ADDR_CNT=4

CONFIG_BT_GATT_DM_MAX_ATTRS=80
CONFIG_BT_GATT_CLIENT=y
CONFIG_BT_GATT_DM=y

# Allow larger GATT notifications (ATT_MTU negotiation).
# Notify payload max is (ATT_MTU - 3). Ensure both peers support the same MTU.
CONFIG_BT_L2CAP_TX_MTU=517

# Make sure host ACL buffers can carry larger L2CAP SDUs when needed.
# (Even with controller fragmentation, larger MTU often benefits from larger buffers/count.)
CONFIG_BT_BUF_ACL_RX_SIZE=521
CONFIG_BT_BUF_ACL_TX_SIZE=521
CONFIG_BT_BUF_ACL_RX_COUNT=10
CONFIG_BT_BUF_ACL_TX_COUNT=10

CONFIG_SETTINGS=y
CONFIG_BT_SETTINGS=y
CONFIG_FLASH=y
CONFIG_FLASH_PAGE_LAYOUT=y
CONFIG_FLASH_MAP=y

CONFIG_HEAP_MEM_POOL_SIZE=1024

CONFIG_DK_LIBRARY=y

CONFIG_LOG=y
CONFIG_CONSOLE=y
CONFIG_LOG_DEFAULT_LEVEL=3
CONFIG_USE_SEGGER_RTT=y
CONFIG_LOG_BACKEND_RTT=y
CONFIG_RTT_CONSOLE=y
CONFIG_PRINTK=y
CONFIG_LOG_MODE_IMMEDIATE=y
CONFIG_UART_CONSOLE=n

CONFIG_BOOTLOADER_MCUBOOT=n
CONFIG_PM_SINGLE_IMAGE=y

################################################################################
# Storage (SD card, FS)
CONFIG_DISK_ACCESS=y
CONFIG_DISK_DRIVER_SDMMC=y
CONFIG_FILE_SYSTEM=y
CONFIG_FAT_FILESYSTEM_ELM=y
CONFIG_SPI_NRFX_RAM_BUFFER_SIZE=64
```

## src/main.c
```c
#include <zephyr/kernel.h>
#include <zephyr/logging/log.h>

#include "ble_relay_control.h"
#include "ui.h"

/* 위 파일의 프로토타입 */
// int central_discovery_start(void);

void main(void)
{
    printk("=============================================\n");
    printk("=============================================\n");
    printk("== Relay Central discovery-subscribe start ==\n");
    printk("=============================================\n");
    printk("=============================================\n");
    int err = led_init();
    if (err) {
        /* LED init failed: show RED 3 times (best-effort). */
        (void)blink_led(RED_LED, 3);
    } else {
        /* Power-on indication: slower RGB sweep + WHITE flash. */
        (void)blink_led(RED_LED, 1);
        k_sleep(K_MSEC(150));
        (void)blink_led(GREEN_LED, 1);
        k_sleep(K_MSEC(150));
        (void)blink_led(BLUE_LED, 1);
        k_sleep(K_MSEC(150));

        (void)led_set(RED_LED, 1);
        (void)led_set(GREEN_LED, 1);
        (void)led_set(BLUE_LED, 1);
        k_sleep(K_MSEC(350));
        (void)led_set(RED_LED, 0);
        (void)led_set(GREEN_LED, 0);
        (void)led_set(BLUE_LED, 0);
        k_sleep(K_MSEC(200));
    }

    (void)ui_status_init();

    ble_relay_control_start();

    while (1) {
        k_sleep(K_MSEC(1000));
    }
}
```
